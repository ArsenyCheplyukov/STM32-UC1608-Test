/* USER CODE BEGIN Header */
/**
  ******************************************************************************
  * @file           : main.h
  * @brief          : Header for main.c file.
  *                   This file contains the common defines of the application.
  ******************************************************************************
  * @attention
  *
  * <h2><center>&copy; Copyright (c) 2022 STMicroelectronics.
  * All rights reserved.</center></h2>
  *
  * This software component is licensed by ST under BSD 3-Clause license,
  * the "License"; You may not use this file except in compliance with the
  * License. You may obtain a copy of the License at:
  *                        opensource.org/licenses/BSD-3-Clause
  *
  ******************************************************************************
  */
/* USER CODE END Header */

/* Define to prevent recursive inclusion -------------------------------------*/
#ifndef __MAIN_H
#define __MAIN_H

#ifdef __cplusplus
extern "C" {
#endif

/* Includes ------------------------------------------------------------------*/
#include "stm32f4xx_hal.h"

/* Private includes ----------------------------------------------------------*/
/* USER CODE BEGIN Includes */

/* USER CODE END Includes */

/* Exported types ------------------------------------------------------------*/
/* USER CODE BEGIN ET */

/* USER CODE END ET */

/* Exported constants --------------------------------------------------------*/
/* USER CODE BEGIN EC */

/* USER CODE END EC */

/* Exported macro ------------------------------------------------------------*/
/* USER CODE BEGIN EM */

/* USER CODE END EM */

void HAL_TIM_MspPostInit(TIM_HandleTypeDef *htim);

/* Exported functions prototypes ---------------------------------------------*/
void Error_Handler(void);

/* USER CODE BEGIN EFP */

/* USER CODE END EFP */

/* Private defines -----------------------------------------------------------*/
#define WR0_Pin GPIO_PIN_1
#define WR0_GPIO_Port GPIOG
#define DB7_Pin GPIO_PIN_2
#define DB7_GPIO_Port GPIOG
#define DB6_Pin GPIO_PIN_3
#define DB6_GPIO_Port GPIOG
#define DB5_Pin GPIO_PIN_4
#define DB5_GPIO_Port GPIOG
#define DB4_Pin GPIO_PIN_5
#define DB4_GPIO_Port GPIOG
#define DB3_Pin GPIO_PIN_6
#define DB3_GPIO_Port GPIOG
#define DB2_Pin GPIO_PIN_7
#define DB2_GPIO_Port GPIOG
#define DB1_Pin GPIO_PIN_8
#define DB1_GPIO_Port GPIOG
#define DB0_Pin GPIO_PIN_9
#define DB0_GPIO_Port GPIOG
#define WR1_Pin GPIO_PIN_12
#define WR1_GPIO_Port GPIOG
#define CD_Pin GPIO_PIN_15
#define CD_GPIO_Port GPIOG

/* USER CODE BEGIN Private defines */
#define skeletor_width 64
#define skeletor_height 64
const static unsigned char skeletor_bits[4][512] = {
 {
    0x00, 0x00, 0x00, 0x00, 0x00, 0x00, 0x00, 0x00, 0x00, 0x00, 0x00, 0xe0,
    0x03, 0x00, 0x00, 0x00, 0x00, 0x00, 0x00, 0x38, 0x0e, 0x00, 0x00, 0x00,
    0x00, 0x00, 0x00, 0xc6, 0x31, 0x00, 0x00, 0x00, 0x00, 0x00, 0x80, 0xf9,
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    0x00, 0x00, 0x00, 0x00, 0x00, 0x00, 0x00, 0x00
  },
  {
    0x00, 0x00, 0x00, 0x00, 0x00, 0x00, 0x00, 0x00, 0x00, 0x00, 0x00, 0xe0,
    0x03, 0x00, 0x00, 0x00, 0x00, 0x00, 0x00, 0x38, 0x0e, 0x00, 0x00, 0x00,
    0x00, 0x00, 0x00, 0xc6, 0x31, 0x00, 0x00, 0x00, 0x00, 0x00, 0x80, 0xf9,
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    0x00, 0x00, 0x00, 0x00, 0x00, 0x00, 0x00, 0x00
  },
  {
    0x00, 0x00, 0x00, 0x3c, 0x1c, 0x00, 0x00, 0x00, 0x00, 0x00, 0x00, 0xc3,
    0xe3, 0x00, 0x00, 0x00, 0x00, 0x00, 0xe0, 0xfc, 0x1f, 0x03, 0x00, 0x00,
    0x00, 0x00, 0x30, 0xff, 0xff, 0x06, 0x00, 0x00, 0x00, 0x00, 0x30, 0xff,
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    0x00, 0x00, 0x00, 0x00, 0x00, 0x00, 0x00, 0x00
  },
  {
    0x00, 0x00, 0x00, 0x3c, 0x1c, 0x00, 0x00, 0x00, 0x00, 0x00, 0x00, 0xc3,
    0xe3, 0x00, 0x00, 0x00, 0x00, 0x00, 0xe0, 0xfc, 0x1f, 0x03, 0x00, 0x00,
    0x00, 0x00, 0x30, 0xff, 0xff, 0x06, 0x00, 0x00, 0x00, 0x00, 0x30, 0xff,
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    0x00, 0x00, 0x00, 0x00, 0x00, 0x00, 0x00, 0x00
  }
};
/* USER CODE END Private defines */

#ifdef __cplusplus
}
#endif

#endif /* __MAIN_H */
